## components/bme680/Kconfig.projbuild
```kconfig
menu "BME680"

    menu "I2C"
        config BME680_I2C_SCL_IO
            int "BME680 SCL GPIO Num"
            default 22
            help
                GPIO number for BME680 I2C clock line.

        config BME680_I2C_SDA_IO
            int "BME680 SDA GPIO Num"
            default 21
            help
                GPIO number for BME680 I2C data line.

        config BME680_I2C_PORT_NUM
            int "Port Number"
            default 1
            help
                Port number for BME680 I2C device.
    endmenu

endmenu
```

## main/Kconfig.projbuild
```kconfig
menu "M5EnvProbe"

config SPIFFS_BASE_ADDR
    int "SPIFFS Base address"
    range 1048576 33546240
    default 1572864
    help
	Starting address of the SPIFFS area in ESP32 Flash

config SPIFFS_SIZE
    int "SPIFFS Size in bytes"
    range 262144 2097152
    default 1048576

config SPIFFS_LOG_BLOCK_SIZE
    int "SPIFFS Logical block size"
    range 4098 65536
    default 8192

config SPIFFS_LOG_PAGE_SIZE
    int "SPIFFS Logical page size"
    range 256 2048
    default 256
    help
	Set it to the phisycal page size og the used SPI Flash chip.

config WIFI_SSID
    string "WiFi SSID"
   	depends on EXAMPLE_USE_WIFI
    default "myssid"
    help
	SSID (network name) for the demo to connect to.

config WIFI_PASSWORD
    string "WiFi Password"
   	depends on EXAMPLE_USE_WIFI
    default "mypassword"
    help
	WiFi password (WPA or WPA2) for the demo to use.


endmenu
```
